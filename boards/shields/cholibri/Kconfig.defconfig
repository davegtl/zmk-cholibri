## boards/shields/cholibri/Kconfig.defconfig
```kconfig
if SHIELD_CHOLIBRI_LEFT

config ZMK_KEYBOARD_NAME
    default "Cholibri"

config ZMK_SPLIT_ROLE_CENTRAL
    default y

endif

if SHIELD_CHOLIBRI_LEFT || SHIELD_CHOLIBRI_RIGHT

config ZMK_SPLIT
    default y

endif
```

## boards/shields/cholibri/Kconfig.shield
```kconfig
config SHIELD_CHOLIBRI_LEFT
    def_bool $(shields_list_contains,cholibri_left)

config SHIELD_CHOLIBRI_RIGHT
    def_bool $(shields_list_contains,cholibri_right)
```
